/*
 * Copyright (c) 2025 Nordic Semiconductor ASA
 *
 * SPDX-License-Identifier: LicenseRef-Nordic-5-Clause
 */

#include "nrf54ls05pdk_nrf54ls05b-pinctrl.dtsi"

/ {
	aliases {
		watchdog0 = &wdt30;
	};
};

&uart20 {
	current-speed = <115200>;
	pinctrl-0 = <&uart20_default>;
	pinctrl-1 = <&uart20_sleep>;
	pinctrl-names = "default", "sleep";
};

&hfpll {
	/* For now use 64 MHz clock for CPU and fast peripherals. */
	clock-frequency = <DT_FREQ_M(64)>;
};
