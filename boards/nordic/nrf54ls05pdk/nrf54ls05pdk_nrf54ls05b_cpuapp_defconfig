## boards/nordic/nrf54ls05pdk/nrf54ls05pdk_nrf54ls05b_cpuapp_defconfig
```kconfig
# Copyright (c) 2025 Nordic Semiconductor ASA
# SPDX-License-Identifier: Apache-2.0

# Enable UART driver
CONFIG_SERIAL=y

# Enable console
CONFIG_CONSOLE=y
CONFIG_UART_CONSOLE=y

# Enable GPIO
CONFIG_GPIO=y

# Enable hardware stack protection
CONFIG_HW_STACK_PROTECTION=y

# Use RC as default source for low frequency clock
CONFIG_CLOCK_CONTROL_NRF_K32SRC_RC=y
```

## tests/drivers/i2s/i2s_profiling/testcase.yaml
```yaml
common:
  tags:
    - drivers
    - ci_tests_zephyr_drivers_i2s

tests:
  drivers.i2s.i2s_profiling.nrf:
    platform_allow:
      - nrf54lm20dk/nrf54lm20a/cpuapp
      - nrf54lm20dk/nrf54lm20b/cpuapp
    integration_platforms:
      - nrf54lm20dk/nrf54lm20b/cpuapp
    extra_args: EXTRA_DTC_OVERLAY_FILE="nrf_tdm.overlay"
    harness: ztest
    harness_config:
      fixture: gpio_loopback
  drivers.i2s.i2s_profiling.nrf.nrf54h:
    platform_allow:
      - nrf54h20dk/nrf54h20/cpuapp
    integration_platforms:
      - nrf54h20dk/nrf54h20/cpuapp
    extra_args: EXTRA_DTC_OVERLAY_FILE="nrf_tdm.overlay"
    harness: ztest
    harness_config:
      fixture: i2s_loopback
  drivers.i2s.i2s_profiling.nrfx:
    platform_allow:
      - nrf54lm20dk/nrf54lm20a/cpuapp
      - nrf54lm20dk/nrf54lm20b/cpuapp
    integration_platforms:
      - nrf54lm20dk/nrf54lm20b/cpuapp
    extra_args: EXTRA_DTC_OVERLAY_FILE="nrfx_tdm.overlay"
    harness: ztest
    harness_config:
      fixture: gpio_loopback
  drivers.i2s.i2s_profiling.nrfx.nrf54h:
    platform_allow:
      - nrf54h20dk/nrf54h20/cpuapp
    integration_platforms:
      - nrf54h20dk/nrf54h20/cpuapp
    extra_args: EXTRA_DTC_OVERLAY_FILE="nrfx_tdm.overlay"
    harness: ztest
    harness_config:
      fixture: i2s_loopback
```

## tests/zephyr/drivers/clock_control/clock_control_api/boards/nrf54ls05pdk_nrf54ls05b_cpuapp.conf
```kconfig
CONFIG_TEST_NRF_HF_STARTUP_TIME_US=2000
CONFIG_CLOCK_CONTROL_NRF_K32SRC_RC_CALIBRATION=n
```
